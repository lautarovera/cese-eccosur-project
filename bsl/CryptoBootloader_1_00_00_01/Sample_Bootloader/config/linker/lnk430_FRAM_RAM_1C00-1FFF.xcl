//*****************************************************************
// Crypto BSL Linker File
//*****************************************************************

// Device summary
//
// Core:                           MSP430X
// Interrupt vectors:              56
// Signature memory:               16 Bytes
// Peripheral units:                   0-00FFF
// Information memory (FRAM):      01800-019FF
// Read/write memory (RAM):        01C00-02BFF
// Persistent memory (FRAM):       04000-0FF7F
//                                 10000-43FF7

// ---------------------------------------------------------
// Configuration
//
// For HW AES
//-DBSL_Limit_L=F000
// For SW AES
-DBSL_Limit_L=E000
-DBSL_Limit_H=FFFF
-DBSL_SignVectors=FF80



// -----------------------------------------------
// Stack and heap sizes
//
// Uncomment for command line use
-D_STACK_SIZE=100
-D_DATA16_HEAP_SIZE=0
-D_DATA20_HEAP_SIZE=0
//-g?mpu2_init
//-g__iar_430_ipe_signature


// -----------------------------------------------
// Define cpu
//

-cmsp430


// -----------------------------------------------
// Support for placing functions in read/write memory
//

-QCODE_I=CODE_ID


// -----------------------------------------------
// Support for thread local storage
//

-QTLS16_I=TLS16_ID


// -----------------------------------------------
// Hardware multiplier location
//

-D__iar_HWMUL=4C0

// ---------------------------------------------------------
// Placement directives
//

// -----------------------------------------------
// RAM memory
//
-Z(DATA)DATA16_I,DATA16_Z,DATA16_N,TLS16_I=1C00-1FFF
-Z(DATA)CODE_I
-Z(DATA)DATA20_I,DATA20_Z,DATA20_N
-Z(DATA)CSTACK+_STACK_SIZE#


// -----------------------------------------------
// FRAM memory

// ---------------------------
// Memory Protection Unit (MPU) border
//
-D_MPU_SEG_B1=(BSL_Limit_L/10)
-D_MPU_SEG_B2=(10000/10)


//
// ---------------------------
// Intellectual Property Encapsulation (IPE)
//
// Protect memory from start of BSL to end of vectors
-Z(CONST)IPE_B1=BSL_Limit_L
-Z(CODE)IPECODE16
-Z(CONST)IPEDATA16_C
-Z(CONST)IPE_B2=10000



// -------------------------------------
// Low memory 0-0FFFF
//
// ---------------------------
// Read/write data in FRAM
//
// -----------------
// User's reset vector
//
-Z(CONST)DATA16_P,DATA20_P=BSL_Limit_L-(BSL_SignVectors-1)
-Z(DATA)DATA16_HEAP+_DATA16_HEAP_SIZE
-Z(DATA)DATA20_HEAP+_DATA20_HEAP_SIZE

// Entry point
-Z(CONST)BSL430_ENTRY_FUNCTION=FF08-FF1F


// ---------------------------
// Constant data
//
-Z(CONST)DATA16_C,DATA16_ID,TLS16_ID,DIFUNCT,CHECKSUM=BSL_Limit_L-(BSL_SignVectors-1)



// ---------------------------
// Code
//
-Z(CODE)CSTART,ISR_CODE,CODE16=BSL_Limit_L-(BSL_SignVectors-1)


// -------------------------------------
// All memory 0-FFFFF
//

// ---------------------------
// Code
//
-P(CODE)CODE=BSL_Limit_L-(BSL_SignVectors-1)
-Z(CODE)CODE_PAD


// ---------------------------
// Constant data
//
-Z(CONST)DATA20_C,DATA20_ID,CODE_ID=BSL_Limit_L-(BSL_SignVectors-1)




// -------------------------------------
// Signature memory and interrupt vectors
//
// BSL Signatures
-Z(CONST)BSLSIG1=FF84-FF85
-Z(CONST)BSLSIG2=FF86-FF87

// JTAG Signatures
-Z(CONST)JTAGLOCK_KEY=FF80-FF83

// IPE Signatures
-Z(CONST)IPESIGNATURE=FF88-FF8F

// Interrupt vectors
-Z(CODE)INTVEC=FF90-FFFF
-Z(CODE)RESET=FFFE-FFFF

// Configuration Constants
// These constants are in IVT region, but these interrupts are not used
// -----------------
// Version Info
//
-Z(CONST)BSL430_VERSION_VENDOR=FFB8-FFB8
-Z(CONST)BSL430_VERSION_CI=FFB9-FFB9
-Z(CONST)BSL430_VERSION_API=FFBA-FFBA
-Z(CONST)BSL430_VERSION_PI=FFBB-FFBB
// -----------------
// BSL Configuration
//
-Z(CONST)BSL430_CONFIG_ENTRY_MODE=FFBC
-Z(CONST)BSL430_CONFIG_COMMANDS=FFBD
-Z(CONST)BSL430_CONFIG_MASSERASE=FFBE


// ---------------------------------------------------------
// The end
// ---------------------------------------------------------
